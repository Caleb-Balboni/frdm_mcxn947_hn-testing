## i3c-test/build/Kconfig/boards/Kconfig.defconfig.tmp
```kconfig
# Load Zephyr board defconfig descriptions.
osource "/home/bionet-caleb/testing/zephyr-testing/zephyr/boards/nxp/frdm_mcxn947_hn/Kconfig.defconfig"
```

## i3c-test/build/Kconfig/boards/Kconfig.frdm_mcxn947_hn
```kconfig
# Load board Kconfig descriptions.
osource "/home/bionet-caleb/testing/zephyr-testing/zephyr/boards/nxp/frdm_mcxn947_hn/Kconfig.frdm_mcxn947_hn"
```

## sd-test/build/Kconfig/boards/Kconfig.tmp
```kconfig
# Load Zephyr board Kconfig descriptions.
osource "/home/bionet-caleb/testing/zephyr-testing/zephyr/boards/nxp/frdm_mcxn947_hn/Kconfig"
```
