## i3c-test/build/Kconfig/arch/Kconfig.tmp
```kconfig
# Load Zephyr Arch Kconfig descriptions.
osource "/home/bionet-caleb/testing/zephyr-testing/zephyr/arch/rx/Kconfig"
osource "/home/bionet-caleb/testing/zephyr-testing/zephyr/arch/x86/Kconfig"
osource "/home/bionet-caleb/testing/zephyr-testing/zephyr/arch/xtensa/Kconfig"
osource "/home/bionet-caleb/testing/zephyr-testing/zephyr/arch/sparc/Kconfig"
osource "/home/bionet-caleb/testing/zephyr-testing/zephyr/arch/riscv/Kconfig"
osource "/home/bionet-caleb/testing/zephyr-testing/zephyr/arch/posix/Kconfig"
osource "/home/bionet-caleb/testing/zephyr-testing/zephyr/arch/mips/Kconfig"
osource "/home/bionet-caleb/testing/zephyr-testing/zephyr/arch/arm64/Kconfig"
osource "/home/bionet-caleb/testing/zephyr-testing/zephyr/arch/arm/Kconfig"
osource "/home/bionet-caleb/testing/zephyr-testing/zephyr/arch/arc/Kconfig"
```

## i3c-test/build/Kconfig/soc/Kconfig.tmp
```kconfig
# Load Zephyr SoC Kconfig descriptions.
osource "/home/bionet-caleb/testing/zephyr-testing/zephyr/soc/xlnx/zynqmp/Kconfig"
osource "/home/bionet-caleb/testing/zephyr-testing/zephyr/soc/xlnx/zynq7000/Kconfig"
osource "/home/bionet-caleb/testing/zephyr-testing/zephyr/soc/xlnx/versalnet/Kconfig"
osource "/home/bionet-caleb/testing/zephyr-testing/zephyr/soc/xlnx/versal2/Kconfig"
osource "/home/bionet-caleb/testing/zephyr-testing/zephyr/soc/xlnx/versal/Kconfig"
osource "/home/bionet-caleb/testing/zephyr-testing/zephyr/soc/xen/Kconfig"
osource "/home/bionet-caleb/testing/zephyr-testing/zephyr/soc/wch/ch32v/Kconfig"
osource "/home/bionet-caleb/testing/zephyr-testing/zephyr/soc/ti/simplelink/Kconfig"
osource "/home/bionet-caleb/testing/zephyr-testing/zephyr/soc/ti/mspm0/Kconfig"
osource "/home/bionet-caleb/testing/zephyr-testing/zephyr/soc/ti/lm3s6965/Kconfig"
osource "/home/bionet-caleb/testing/zephyr-testing/zephyr/soc/ti/k3/Kconfig"
osource "/home/bionet-caleb/testing/zephyr-testing/zephyr/soc/telink/tlsr/Kconfig"
osource "/home/bionet-caleb/testing/zephyr-testing/zephyr/soc/starfive/jh71xx/Kconfig"
osource "/home/bionet-caleb/testing/zephyr-testing/zephyr/soc/st/stm32/Kconfig"
osource "/home/bionet-caleb/testing/zephyr-testing/zephyr/soc/snps/qemu_arc/Kconfig"
osource "/home/bionet-caleb/testing/zephyr-testing/zephyr/soc/snps/nsim/arc_v/Kconfig"
osource "/home/bionet-caleb/testing/zephyr-testing/zephyr/soc/snps/nsim/arc_classic/Kconfig"
osource "/home/bionet-caleb/testing/zephyr-testing/zephyr/soc/snps/hsdk4xd/Kconfig"
osource "/home/bionet-caleb/testing/zephyr-testing/zephyr/soc/snps/hsdk/Kconfig"
osource "/home/bionet-caleb/testing/zephyr-testing/zephyr/soc/snps/emsk/Kconfig"
osource "/home/bionet-caleb/testing/zephyr-testing/zephyr/soc/snps/emsdp/Kconfig"
osource "/home/bionet-caleb/testing/zephyr-testing/zephyr/soc/snps/arc_iot/Kconfig"
osource "/home/bionet-caleb/testing/zephyr-testing/zephyr/soc/silabs/Kconfig"
osource "/home/bionet-caleb/testing/zephyr-testing/zephyr/soc/sifli/sf32/Kconfig"
osource "/home/bionet-caleb/testing/zephyr-testing/zephyr/soc/sifive/sifive_freedom/Kconfig"
osource "/home/bionet-caleb/testing/zephyr-testing/zephyr/soc/sensry/Kconfig"
osource "/home/bionet-caleb/testing/zephyr-testing/zephyr/soc/rockchip/Kconfig"
osource "/home/bionet-caleb/testing/zephyr-testing/zephyr/soc/renode/riscv_virtual/Kconfig"
osource "/home/bionet-caleb/testing/zephyr-testing/zephyr/soc/renode/cortex_r8_virtual/Kconfig"
osource "/home/bionet-caleb/testing/zephyr-testing/zephyr/soc/renesas/smartbond/Kconfig"
osource "/home/bionet-caleb/testing/zephyr-testing/zephyr/soc/renesas/rz/Kconfig"
osource "/home/bionet-caleb/testing/zephyr-testing/zephyr/soc/renesas/rx/Kconfig"
osource "/home/bionet-caleb/testing/zephyr-testing/zephyr/soc/renesas/rcar/Kconfig"
osource "/home/bionet-caleb/testing/zephyr-testing/zephyr/soc/renesas/ra/Kconfig"
osource "/home/bionet-caleb/testing/zephyr-testing/zephyr/soc/realtek/ec/Kconfig"
osource "/home/bionet-caleb/testing/zephyr-testing/zephyr/soc/realtek/ameba/Kconfig"
osource "/home/bionet-caleb/testing/zephyr-testing/zephyr/soc/raspberrypi/rpi_pico/Kconfig"
osource "/home/bionet-caleb/testing/zephyr-testing/zephyr/soc/quicklogic/eos_s3/Kconfig"
osource "/home/bionet-caleb/testing/zephyr-testing/zephyr/soc/qemu/virt_riscv/Kconfig"
osource "/home/bionet-caleb/testing/zephyr-testing/zephyr/soc/qemu/malta/Kconfig"
osource "/home/bionet-caleb/testing/zephyr-testing/zephyr/soc/openisa/rv32m1/Kconfig"
osource "/home/bionet-caleb/testing/zephyr-testing/zephyr/soc/openhwgroup/cva6/Kconfig"
osource "/home/bionet-caleb/testing/zephyr-testing/zephyr/soc/oct/osd32mp15x/Kconfig"
osource "/home/bionet-caleb/testing/zephyr-testing/zephyr/soc/nxp/s32/Kconfig"
osource "/home/bionet-caleb/testing/zephyr-testing/zephyr/soc/nxp/rw/Kconfig"
osource "/home/bionet-caleb/testing/zephyr-testing/zephyr/soc/nxp/mcx/Kconfig"
osource "/home/bionet-caleb/testing/zephyr-testing/zephyr/soc/nxp/lpc/Kconfig"
osource "/home/bionet-caleb/testing/zephyr-testing/zephyr/soc/nxp/layerscape/Kconfig"
osource "/home/bionet-caleb/testing/zephyr-testing/zephyr/soc/nxp/kinetis/Kconfig"
osource "/home/bionet-caleb/testing/zephyr-testing/zephyr/soc/nxp/imxrt/Kconfig"
osource "/home/bionet-caleb/testing/zephyr-testing/zephyr/soc/nxp/imx/Kconfig"
osource "/home/bionet-caleb/testing/zephyr-testing/zephyr/soc/nuvoton/numicro/Kconfig"
osource "/home/bionet-caleb/testing/zephyr-testing/zephyr/soc/nuvoton/numaker/Kconfig"
osource "/home/bionet-caleb/testing/zephyr-testing/zephyr/soc/nuvoton/npcx/Kconfig"
osource "/home/bionet-caleb/testing/zephyr-testing/zephyr/soc/nuvoton/npcm/Kconfig"
osource "/home/bionet-caleb/testing/zephyr-testing/zephyr/soc/nordic/Kconfig"
osource "/home/bionet-caleb/testing/zephyr-testing/zephyr/soc/neorv32/Kconfig"
osource "/home/bionet-caleb/testing/zephyr-testing/zephyr/soc/native/inf_clock/Kconfig"
osource "/home/bionet-caleb/testing/zephyr-testing/zephyr/soc/microchip/sam/sama7/Kconfig"
osource "/home/bionet-caleb/testing/zephyr-testing/zephyr/soc/microchip/sam/sam_d5x_e5x/Kconfig"
osource "/home/bionet-caleb/testing/zephyr-testing/zephyr/soc/microchip/pic32c/pic32cz_ca/Kconfig"
osource "/home/bionet-caleb/testing/zephyr-testing/zephyr/soc/microchip/pic32c/pic32cx_sg/Kconfig"
osource "/home/bionet-caleb/testing/zephyr-testing/zephyr/soc/microchip/pic32c/pic32cm_jh/Kconfig"
osource "/home/bionet-caleb/testing/zephyr-testing/zephyr/soc/microchip/miv/Kconfig"
osource "/home/bionet-caleb/testing/zephyr-testing/zephyr/soc/microchip/mec/Kconfig"
osource "/home/bionet-caleb/testing/zephyr-testing/zephyr/soc/mediatek/mt8xxx/Kconfig"
osource "/home/bionet-caleb/testing/zephyr-testing/zephyr/soc/lowrisc/opentitan/Kconfig"
osource "/home/bionet-caleb/testing/zephyr-testing/zephyr/soc/litex/litex_vexriscv/Kconfig"
osource "/home/bionet-caleb/testing/zephyr-testing/zephyr/soc/ite/ec/Kconfig"
osource "/home/bionet-caleb/testing/zephyr-testing/zephyr/soc/intel/wildcat_lake/Kconfig"
osource "/home/bionet-caleb/testing/zephyr-testing/zephyr/soc/intel/raptor_lake/Kconfig"
osource "/home/bionet-caleb/testing/zephyr-testing/zephyr/soc/intel/panther_lake/Kconfig"
osource "/home/bionet-caleb/testing/zephyr-testing/zephyr/soc/intel/lakemont/Kconfig"
osource "/home/bionet-caleb/testing/zephyr-testing/zephyr/soc/intel/intel_socfpga_std/Kconfig"
osource "/home/bionet-caleb/testing/zephyr-testing/zephyr/soc/intel/intel_socfpga/Kconfig"
osource "/home/bionet-caleb/testing/zephyr-testing/zephyr/soc/intel/intel_niosv/Kconfig"
osource "/home/bionet-caleb/testing/zephyr-testing/zephyr/soc/intel/intel_ish/Kconfig"
osource "/home/bionet-caleb/testing/zephyr-testing/zephyr/soc/intel/intel_adsp/Kconfig"
osource "/home/bionet-caleb/testing/zephyr-testing/zephyr/soc/intel/elkhart_lake/Kconfig"
osource "/home/bionet-caleb/testing/zephyr-testing/zephyr/soc/intel/atom/Kconfig"
osource "/home/bionet-caleb/testing/zephyr-testing/zephyr/soc/intel/apollo_lake/Kconfig"
osource "/home/bionet-caleb/testing/zephyr-testing/zephyr/soc/intel/alder_lake/Kconfig"
osource "/home/bionet-caleb/testing/zephyr-testing/zephyr/soc/infineon/psoc4/Kconfig"
osource "/home/bionet-caleb/testing/zephyr-testing/zephyr/soc/infineon/edge/Kconfig"
osource "/home/bionet-caleb/testing/zephyr-testing/zephyr/soc/infineon/cat3/Kconfig"
osource "/home/bionet-caleb/testing/zephyr-testing/zephyr/soc/infineon/cat1c/Kconfig"
osource "/home/bionet-caleb/testing/zephyr-testing/zephyr/soc/infineon/cat1b/Kconfig"
osource "/home/bionet-caleb/testing/zephyr-testing/zephyr/soc/infineon/cat1a/Kconfig"
osource "/home/bionet-caleb/testing/zephyr-testing/zephyr/soc/gd/gd32/Kconfig"
osource "/home/bionet-caleb/testing/zephyr-testing/zephyr/soc/gaisler/leon3/Kconfig"
osource "/home/bionet-caleb/testing/zephyr-testing/zephyr/soc/gaisler/gr716a/Kconfig"
osource "/home/bionet-caleb/testing/zephyr-testing/zephyr/soc/focaltech/Kconfig"
osource "/home/bionet-caleb/testing/zephyr-testing/zephyr/soc/espressif/Kconfig"
osource "/home/bionet-caleb/testing/zephyr-testing/zephyr/soc/ene/kb1200/Kconfig"
osource "/home/bionet-caleb/testing/zephyr-testing/zephyr/soc/ene/kb106x/Kconfig"
osource "/home/bionet-caleb/testing/zephyr-testing/zephyr/soc/elan/em32f967/Kconfig"
osource "/home/bionet-caleb/testing/zephyr-testing/zephyr/soc/egis/Kconfig"
osource "/home/bionet-caleb/testing/zephyr-testing/zephyr/soc/efinix/sapphire/Kconfig"
osource "/home/bionet-caleb/testing/zephyr-testing/zephyr/soc/cdns/xtensa_sample_controller/Kconfig"
osource "/home/bionet-caleb/testing/zephyr-testing/zephyr/soc/cdns/sample_controller32/Kconfig"
osource "/home/bionet-caleb/testing/zephyr-testing/zephyr/soc/cdns/dc233c/Kconfig"
osource "/home/bionet-caleb/testing/zephyr-testing/zephyr/soc/brcm/bcmvk/Kconfig"
osource "/home/bionet-caleb/testing/zephyr-testing/zephyr/soc/brcm/bcm2712/Kconfig"
osource "/home/bionet-caleb/testing/zephyr-testing/zephyr/soc/brcm/bcm2711/Kconfig"
osource "/home/bionet-caleb/testing/zephyr-testing/zephyr/soc/bflb/Kconfig"
osource "/home/bionet-caleb/testing/zephyr-testing/zephyr/soc/atmel/sam0/Kconfig"
osource "/home/bionet-caleb/testing/zephyr-testing/zephyr/soc/atmel/sam/Kconfig"
osource "/home/bionet-caleb/testing/zephyr-testing/zephyr/soc/aspeed/Kconfig"
osource "/home/bionet-caleb/testing/zephyr-testing/zephyr/soc/arm/Kconfig"
osource "/home/bionet-caleb/testing/zephyr-testing/zephyr/soc/arm/beetle/Kconfig"
osource "/home/bionet-caleb/testing/zephyr-testing/zephyr/soc/antmicro/myra/Kconfig"
osource "/home/bionet-caleb/testing/zephyr-testing/zephyr/soc/andestech/Kconfig"
osource "/home/bionet-caleb/testing/zephyr-testing/zephyr/soc/amd/acp_6_0/Kconfig"
osource "/home/bionet-caleb/testing/zephyr-testing/zephyr/soc/ambiq/Kconfig"
osource "/home/bionet-caleb/testing/zephyr-testing/zephyr/soc/aesc/Kconfig"
osource "/home/bionet-caleb/testing/zephyr-testing/zephyr/soc/adi/max32/Kconfig"
```
